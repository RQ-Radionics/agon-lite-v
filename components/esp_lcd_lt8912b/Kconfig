## components/esp_lcd_lt8912b/Kconfig
```kconfig
menu "LT8912B HDMI Bridge"
    depends on IDF_TARGET_ESP32P4

    config LT8912B_ENABLED
        bool "Enable LT8912B HDMI bridge driver"
        default n
        help
            Enable the LT8912B MIPI DSI to HDMI bridge driver.
            Required for HDMI output on boards with an LT8912B chip
            (e.g. Olimex ESP32-P4-PC).

    if LT8912B_ENABLED

    config LT8912B_I2C_PORT
        int "I2C port number"
        default 1
        range 0 1
        help
            I2C port used to configure the LT8912B (sub-addresses 0x48/0x49/0x4A).

    config LT8912B_SDA_GPIO
        int "I2C SDA GPIO"
        default 23

    config LT8912B_SCL_GPIO
        int "I2C SCL GPIO"
        default 22

    config LT8912B_HPD_GPIO
        int "HDMI Hot-Plug Detect GPIO (-1 = disabled)"
        default 15
        range -1 56

    config LT8912B_HDMI_MODE
        bool "HDMI mode (vs DVI)"
        default y

    config LT8912B_DSI_LANES
        int "DSI lane count"
        default 2
        range 1 2

    config LT8912B_DSI_LANE_MBPS
        int "DSI lane bit rate (Mbps)"
        default 350
        help
            MIPI DSI bit rate per lane in Mbps.
            Must satisfy: lane_mbps >= pclk_mhz * 24 / num_lanes (with margin).
            1024x768@60Hz/60MHz/2lanes: 60*24/2=720 Mbps → use 896 Mbps.

    # ---------------------------------------------------------------
    # Video timing — single source of truth for all timing parameters.
    # The same values are used by:
    #   - esp_lcd_lt8912b.c  (LT8912B register writes)
    #   - main.c             (DPI panel config passed to IDF)
    # ---------------------------------------------------------------

    config LT8912B_HACT
        int "Horizontal active pixels"
        default 1024
        help
            Horizontal active pixel count (e.g. 1024 for 1024x768).

    config LT8912B_VACT
        int "Vertical active lines"
        default 768
        help
            Vertical active line count (e.g. 768 for 1024x768).

    config LT8912B_PCLK_MHZ
        int "Pixel clock (MHz)"
        default 60
        help
            Pixel clock in MHz. Must be an exact divisor of the DPI clock source.
            DPI clock source = PLL_F240M (240 MHz).
            Valid exact values: 240/4=60, 240/5=48, 240/6=40, 240/8=30 MHz.
            Use 60 MHz for 1024x768@60Hz.

    config LT8912B_HS
        int "Horizontal sync width (pixels)"
        default 8
        help
            Horizontal sync pulse width in pixels.

    config LT8912B_HFP
        int "Horizontal front porch (pixels)"
        default 48
        help
            Horizontal front porch in pixels.

    config LT8912B_HBP
        int "Horizontal back porch (pixels)"
        default 140
        help
            Horizontal back porch in pixels.
            htotal = hact + hs + hfp + hbp.
            1024x768@60Hz/60MHz: htotal=1220, hblank=196 (hs=8 hfp=48 hbp=140).

    config LT8912B_VS
        int "Vertical sync width (lines)"
        default 6
        help
            Vertical sync pulse width in lines.

    config LT8912B_VFP
        int "Vertical front porch (lines)"
        default 3
        help
            Vertical front porch in lines.

    config LT8912B_VBP
        int "Vertical back porch (lines)"
        default 42
        help
            Vertical back porch in lines.
            vtotal = vact + vs + vfp + vbp.
            1024x768@60Hz/60MHz: vtotal=819, vblank=51 (vs=6 vfp=3 vbp=42).

    config LT8912B_HSYNC_POL
        int "Horizontal sync polarity (1=positive, 0=negative)"
        default 1
        range 0 1

    config LT8912B_VSYNC_POL
        int "Vertical sync polarity (1=positive, 0=negative)"
        default 0
        range 0 1

    config LT8912B_SETTLE
        hex "MIPI DSI settle register (0x49:0x11)"
        default 0x10
        help
            MIPI DSI settle time register value.
            0x04 for vactive <= 600, 0x10 for vactive >= 768.

    config LT8912B_DDS_0
        hex "DDS frequency word byte 0 (LSB, reg 0x4E)"
        default 0x28
        help
            strm_sw_freq_word[7:0] = (pclk_mhz * 0x16C16) & 0xFF.
            60 MHz: 60 * 0x16C16 = 0x555528 → byte0=0x28.

    config LT8912B_DDS_1
        hex "DDS frequency word byte 1 (reg 0x4F)"
        default 0x55
        help
            strm_sw_freq_word[15:8] = (pclk_mhz * 0x16C16 >> 8) & 0xFF.
            60 MHz: 0x555528 → byte1=0x55.

    config LT8912B_DDS_2
        hex "DDS frequency word byte 2 (MSB, reg 0x50)"
        default 0x55
        help
            strm_sw_freq_word[23:16] = (pclk_mhz * 0x16C16 >> 16) & 0xFF.
            60 MHz: 0x555528 → byte2=0x55.

    endif # LT8912B_ENABLED

endmenu
```

## components/mos_audio/Kconfig
```kconfig
menu "MOS Audio (ES8311 codec)"
    depends on IDF_TARGET_ESP32P4

    config MOS_AUDIO_ENABLED
        bool "Enable ES8311 audio codec driver"
        default n
        help
            Enable the ES8311 I2S/I2C audio codec driver.
            Required for audio output/input on boards with an ES8311 chip
            (e.g. Olimex ESP32-P4-PC).

    if MOS_AUDIO_ENABLED

    config MOS_AUDIO_I2C_PORT
        int "I2C port number for ES8311"
        default 0
        range 0 1
        help
            I2C port used to configure the ES8311 (address 0x18).
            Olimex ESP32-P4-PC uses I2C_NUM_0 (port 0), GPIO7/8.

    config MOS_AUDIO_I2C_SDA_GPIO
        int "I2C SDA GPIO for ES8311"
        default 7
        help
            GPIO for I2C SDA to the ES8311. Olimex ESP32-P4-PC: GPIO7.

    config MOS_AUDIO_I2C_SCL_GPIO
        int "I2C SCL GPIO for ES8311"
        default 8
        help
            GPIO for I2C SCL to the ES8311. Olimex ESP32-P4-PC: GPIO8.

    config MOS_AUDIO_PWR_GPIO
        int "Codec power-enable GPIO (active LOW, -1 to disable)"
        default 6
        range -1 56
        help
            GPIO to power-enable the codec. Drive LOW to power on.
            Olimex ESP32-P4-PC: GPIO6 (CODEC_PWR_DIS#, active LOW).
            Set to -1 if no power-enable GPIO is needed.

    config MOS_AUDIO_PA_GPIO
        int "Speaker power-amplifier enable GPIO (active HIGH, -1 to disable)"
        default 53
        range -1 56
        help
            GPIO to enable the speaker power amplifier. Drive HIGH to enable.
            Olimex ESP32-P4-PC: GPIO53 (BSP_POWER_AMP_IO, active HIGH).
            Set to -1 if no PA enable GPIO is needed.

    config MOS_AUDIO_I2S_NUM
        int "I2S port number"
        default 0
        range 0 1
        help
            I2S port number. Olimex ESP32-P4-PC: I2S0 (port 0).

    config MOS_AUDIO_I2S_DOUT_GPIO
        int "I2S DOUT (ESP→codec DAC) GPIO"
        default 9
        help
            I2S data output GPIO (ESP32 → ES8311 DAC input).
            Olimex ESP32-P4-PC: GPIO9 (I2S_DSDIN).

    config MOS_AUDIO_I2S_WS_GPIO
        int "I2S WS (LRCK) GPIO"
        default 10
        help
            I2S word-select (left-right clock) GPIO.
            Olimex ESP32-P4-PC: GPIO10 (I2S_LRCK).

    config MOS_AUDIO_I2S_DIN_GPIO
        int "I2S DIN (codec ADC→ESP) GPIO"
        default 11
        help
            I2S data input GPIO (ES8311 ADC output → ESP32).
            Olimex ESP32-P4-PC: GPIO11 (I2S_ASDOUT).

    config MOS_AUDIO_I2S_BCLK_GPIO
        int "I2S BCLK GPIO"
        default 12
        help
            I2S bit-clock GPIO.
            Olimex ESP32-P4-PC: GPIO12 (I2S_SCLK).

    config MOS_AUDIO_I2S_MCLK_GPIO
        int "I2S MCLK GPIO"
        default 13
        help
            I2S master-clock GPIO (256×fs = 4.194304 MHz for 16384 Hz).
            Olimex ESP32-P4-PC: GPIO13 (I2S_MCLK).

    config MOS_AUDIO_SAMPLE_RATE
        int "Audio sample rate (Hz)"
        default 16384
        help
            Sample rate in Hz. BBC Micro / Agon audio uses 16384 Hz mono.
            The ES8311 and I2S APLL are configured for this exact rate.
            MCLK = 256 * sample_rate = 4,194,304 Hz.

    endif # MOS_AUDIO_ENABLED

endmenu
```

## components/mos_kbd/Kconfig
```kconfig
menu "MOS Keyboard (USB HID)"

config MOS_KBD_ENABLED
    bool "Enable USB HID keyboard driver"
    default n
    help
        Enable the mos_kbd driver which uses the USB host stack to receive
        HID keyboard events from a USB keyboard connected via a FE1.1s hub.
        Produces PS/2 Set 2 scancodes for the VDP internal layer.

if MOS_KBD_ENABLED

config MOS_KBD_HUB_RST_GPIO
    int "GPIO for hub reset (HUB_RST#, active LOW)"
    default 21
    help
        GPIO connected to the active-LOW reset pin of the FE1.1s USB hub.
        The driver drives this HIGH (deassert reset) before starting the
        USB host stack, and LOW briefly on shutdown.

config MOS_KBD_USB_DP_GPIO
    int "GPIO for USB D+ (OTG20 HS)"
    default 25
    help
        GPIO used for D+ of the USB High-Speed PHY0 (OTG20).
        On Olimex ESP32-P4-PC: GPIO25 (same as production test).

config MOS_KBD_USB_DM_GPIO
    int "GPIO for USB D- (OTG20 HS)"
    default 24
    help
        GPIO used for D- of the USB High-Speed PHY0 (OTG20).
        On Olimex ESP32-P4-PC: GPIO24 (same as production test).

endif # MOS_KBD_ENABLED

endmenu
```

## components/mos_net/Kconfig
```kconfig
menu "MOS Network"

    choice MOS_NET_BACKEND
        prompt "Network backend"
        default MOS_NET_WIFI
        help
            Select the network interface to use for IP connectivity.
            Only one backend is active at a time.

        config MOS_NET_WIFI
            bool "WiFi (via coprocessor)"
            help
                Use WiFi via the esp-hosted C6 coprocessor over SDIO.
                Requires CONFIG_MOS_WIFI_ENABLED=y.
                Suitable for boards with a C6 coprocessor (e.g. Waveshare ESP32-P4-WIFI6).

        config MOS_NET_ETHERNET
            bool "Ethernet (RMII)"
            help
                Use the on-chip EMAC with an external RMII PHY.
                Suitable for boards with a wired Ethernet port
                (e.g. Olimex ESP32-P4-PC with IP101GRR PHY).

        config MOS_NET_NONE
            bool "None (no network)"
            help
                Disable all networking. VDP, SNTP and WiFi features are skipped.

    endchoice

    if MOS_NET_ETHERNET

        config MOS_ETH_PHY_ADDR
            int "PHY address (MDIO)"
            default 1
            range 0 31
            help
                MDIO address of the Ethernet PHY chip.
                Olimex ESP32-P4-PC: IP101GRR strapped to address 1.

        config MOS_ETH_RMII_CLK_GPIO
            int "RMII clock GPIO (50 MHz from PHY)"
            default 50
            help
                GPIO receiving the 50 MHz reference clock from the PHY (RMII external clock mode).
                Olimex ESP32-P4-PC: GPIO50 (RXCLK/50M_CLKO of IP101GRR).

        config MOS_ETH_TXEN_GPIO
            int "RMII TXEN GPIO"
            default 33

        config MOS_ETH_TXD0_GPIO
            int "RMII TXD0 GPIO"
            default 34

        config MOS_ETH_TXD1_GPIO
            int "RMII TXD1 GPIO"
            default 35

        config MOS_ETH_RXD0_GPIO
            int "RMII RXD0 GPIO"
            default 29

        config MOS_ETH_RXD1_GPIO
            int "RMII RXD1 GPIO"
            default 30

        config MOS_ETH_RXDV_GPIO
            int "RMII RXDV (CRS_DV) GPIO"
            default 28

        config MOS_ETH_MDC_GPIO
            int "MDC GPIO"
            default 36

        config MOS_ETH_MDIO_GPIO
            int "MDIO GPIO"
            default 37
            help
                MDIO management data GPIO.
                Check schematic net 'MDIO' for the exact GPIO on your board.

        config MOS_ETH_PHY_RST_GPIO
            int "PHY RESET_N GPIO (-1 = not connected)"
            default -1
            help
                GPIO driving the PHY RESET_N pin, active LOW.
                Set to -1 if the PHY reset is not controllable from the ESP32.

        config MOS_ETH_LINK_TIMEOUT_MS
            int "Link-up timeout (ms)"
            default 5000
            help
                Maximum time to wait for Ethernet link + DHCP IP assignment.
                If the cable is unplugged, init returns -1 after this timeout
                and the system continues without network.

    endif

endmenu
```

## components/mos_vdp_internal/Kconfig
```kconfig
menu "MOS VDP Internal (HDMI framebuffer)"

config MOS_VDP_INTERNAL_ENABLED
    bool "Enable internal VDP (HDMI framebuffer renderer)"
    default n
    help
        Enable the internal VDP component which renders Agon video commands
        directly to an RGB888 framebuffer in PSRAM, outputting via the DPI
        panel to the LT8912B HDMI bridge.

        Requires CONFIG_LT8912B_ENABLED=y.

if MOS_VDP_INTERNAL_ENABLED

config MOS_VDP_INTERNAL_DEFAULT_MODE
    int "Default video mode at startup"
    default 0
    range 0 3
    help
        Agon video mode to use at startup.
          0 = 640x480, 16 colours, 80x60 chars (8x8 font)
          1 = 512x384, 16 colours, 64x48 chars
          2 = 320x200,  4 colours, 40x25 chars
          3 = 640x480,  4 colours, 80x60 chars

config MOS_VDP_INTERNAL_TASK_STACK_KB
    int "Render task stack size (KB)"
    default 16
    range 8 64
    help
        Stack size for the VDP render task. The task processes VDU commands
        and updates the framebuffer. Increase if you see stack overflow panics.

endif # MOS_VDP_INTERNAL_ENABLED

endmenu
```

## components/mos_wifi/Kconfig
```kconfig
menu "MOS WiFi"

    config MOS_WIFI_ENABLED
        bool
        default y if MOS_NET_WIFI
        default n
        help
            Automatically enabled when the network backend is WiFi
            (CONFIG_MOS_NET_WIFI=y). Do not set this directly.

endmenu
```

## sdkconfig.defaults
```kconfig
# ESP32-MOS SDK defaults — common configuration
# Target-specific settings go in sdkconfig.defaults.<target>

# Custom partition table
CONFIG_PARTITION_TABLE_CUSTOM=y
CONFIG_PARTITION_TABLE_CUSTOM_FILENAME="partitions.csv"

# FAT filesystem + Wear Levelling
# flash_data.sh generates a raw FAT image (fatfsgen.py) and then injects
# WL state/config blocks (wl_wrap.py) to match these settings exactly.
CONFIG_FATFS_SECTOR_512=y
CONFIG_FATFS_LFN_HEAP=y
CONFIG_FATFS_MAX_LFN=255
CONFIG_WL_SECTOR_SIZE_512=y
CONFIG_WL_SECTOR_MODE_PERF=y

# UART console on UART0
CONFIG_ESP_CONSOLE_UART_DEFAULT=y
CONFIG_ESP_CONSOLE_UART_NUM=0
CONFIG_ESP_CONSOLE_UART_BAUDRATE=115200

# FreeRTOS tick rate
CONFIG_FREERTOS_HZ=1000

# PSRAM (for user program loading)
CONFIG_SPIRAM=y
CONFIG_SPIRAM_ALLOW_BSS_SEG_EXTERNAL_MEMORY=y

# sys_evt task stack — default 2304 is too small with PSRAM/logging overhead
CONFIG_ESP_SYSTEM_EVENT_TASK_STACK_SIZE=4096

# Main task stack size (shell needs decent stack)
CONFIG_ESP_MAIN_TASK_STACK_SIZE=8192

# Log level
CONFIG_LOG_DEFAULT_LEVEL_INFO=y
CONFIG_LOG_DEFAULT_LEVEL=3

# lwIP: allow fast socket rebind after disconnect (needed by FTP server)
CONFIG_LWIP_SO_REUSE=y

# Task watchdog — do NOT check IDLE tasks.
# user_prog and vdp_render legitimately saturate CPUs during rendering;
# the IDLE task starvation WDT fires spuriously and causes DMA crashes.
CONFIG_ESP_TASK_WDT_CHECK_IDLE_TASK_CPU0=n
CONFIG_ESP_TASK_WDT_CHECK_IDLE_TASK_CPU1=n
```
