## sdkconfig.defaults.esp32p4
```kconfig
# ESP32-MOS — ESP32-P4 target-specific settings

# Main task stack — BBC BASIC (bbeval/bbexec) recurse deeply on RISC-V ABI;
# 8KB (default) overflows. 32KB is safe.
CONFIG_ESP_MAIN_TASK_STACK_SIZE=32768

# Chip revision: support v1.x silicon (Waveshare ESP32-P4-WIFI6 uses v1.3)
# v1.x and v3.x are mutually exclusive silicon families; select <v3 mode.
CONFIG_ESP32P4_SELECTS_REV_LESS_V3=y
CONFIG_ESP32P4_REV_MIN_100=y
CONFIG_ESP32P4_REV_MIN_FULL=100

# Flash size 16MB (ESP32-P4-Function-EV-Board default)
CONFIG_ESPTOOLPY_FLASHSIZE_16MB=y
CONFIG_ESPTOOLPY_FLASHSIZE="16MB"

# PSRAM: Hex-line 200 MHz (ESP32-P4 uses 16-line PSRAM interface)
CONFIG_SPIRAM_MODE_HEX=y
CONFIG_SPIRAM_SPEED_200M=y

# Disable PMP memory protection: user programs execute from PSRAM
CONFIG_ESP_SYSTEM_MEMPROT_FEATURE=n

# WiFi via ESP32-C6 coprocessor (ESP-Hosted over SDIO, Slot 1)
# The C6 slave must be flashed with esp-hosted-mcu firmware
# Pin mapping for Waveshare ESP32-P4-WIFI6:
#   CLK=GPIO18  CMD=GPIO19  D0=GPIO14  D1=GPIO15  D2=GPIO16  D3=GPIO17
#   C6 EN/reset = GPIO54 (active HIGH)
CONFIG_SLAVE_IDF_TARGET_ESP32C6=y
CONFIG_ESP_HOSTED_SDIO_HOST_INTERFACE=y
CONFIG_ESP_HOSTED_SDIO_SLOT_1=y
CONFIG_ESP_HOSTED_PRIV_SDIO_PIN_CLK_SLOT_1=18
CONFIG_ESP_HOSTED_PRIV_SDIO_PIN_CMD_SLOT_1=19
CONFIG_ESP_HOSTED_PRIV_SDIO_PIN_D0_SLOT_1=14
CONFIG_ESP_HOSTED_PRIV_SDIO_PIN_D1_4BIT_BUS_SLOT_1=15
CONFIG_ESP_HOSTED_PRIV_SDIO_PIN_D2_4BIT_BUS_SLOT_1=16
CONFIG_ESP_HOSTED_PRIV_SDIO_PIN_D3_4BIT_BUS_SLOT_1=17
CONFIG_ESP_HOSTED_SDIO_GPIO_RESET_SLAVE=54

# WiFi remote buffer tuning (WIFI_RMT_ prefix, not ESP_WIFI_)
CONFIG_WIFI_RMT_STATIC_RX_BUFFER_NUM=16
CONFIG_WIFI_RMT_DYNAMIC_RX_BUFFER_NUM=64
CONFIG_WIFI_RMT_DYNAMIC_TX_BUFFER_NUM=64
CONFIG_WIFI_RMT_AMPDU_TX_ENABLED=y
CONFIG_WIFI_RMT_TX_BA_WIN=32
CONFIG_WIFI_RMT_AMPDU_RX_ENABLED=y
CONFIG_WIFI_RMT_RX_BA_WIN=32

# lwIP tuning for decent throughput over SDIO link
CONFIG_LWIP_TCP_SND_BUF_DEFAULT=65534
CONFIG_LWIP_TCP_WND_DEFAULT=65534
CONFIG_LWIP_TCP_RECVMBOX_SIZE=64
CONFIG_LWIP_UDP_RECVMBOX_SIZE=64
CONFIG_LWIP_TCPIP_RECVMBOX_SIZE=64
CONFIG_LWIP_TCP_SACK_OUT=y
```

## sdkconfig.defaults.esp32s3
```kconfig
# ESP32-MOS — ESP32-S3 target-specific settings

# Flash size 8MB
CONFIG_ESPTOOLPY_FLASHSIZE_8MB=y
CONFIG_ESPTOOLPY_FLASHSIZE="8MB"

# PSRAM: Octal SPI, 80 MHz
CONFIG_SPIRAM_MODE_OCT=y
CONFIG_SPIRAM_SPEED_80M=y

# Disable memory protection: user programs run from PSRAM IBUS window (0x42...),
# l32r reads literals from that same IBUS range as data — PMS blocks this by default.
CONFIG_ESP_SYSTEM_MEMPROT_FEATURE=n
```

## sdkconfig.defaults.olimex-p4pc
```kconfig
# ESP32-MOS — Olimex ESP32-P4-PC target-specific settings
#
# Board: Olimex ESP32-P4-PC
#   Chip:  ESP32-P4NRW32 (dual-core RISC-V 400 MHz, 768 KB RAM, 32 MB PSRAM)
#   Flash: 16 MB SPI
#   WiFi:  none (P4NRW32 has no wireless coprocessor)
#   USB:   USB-JTAG via USB-C (programming + console)
#   ETH:   internal RMII MAC + external PHY
#   SD:    SDMMC slot 0, GPIO 39-44, PWR GPIO 45 (active LOW)
#   Audio: ES8311 codec, I2C1 GPIO7/8, I2S0 GPIO9-13

# Main task stack — app_main() only does NVS init, flash mount, and spawns
# mos_main_task with a 192KB PSRAM stack. It needs very little stack itself.
# 8KB matches the base sdkconfig.defaults value and avoids heap fragmentation
# that caused xTaskCreatePinnedToCore to return pdFAIL with the 65KB value.
CONFIG_ESP_MAIN_TASK_STACK_SIZE=8192

# Chip revision: Olimex uses ESP32-P4NRW32 rev 1.x silicon
# v1.x and v3.x are mutually exclusive silicon families; select <v3 mode.
CONFIG_ESP32P4_SELECTS_REV_LESS_V3=y
CONFIG_ESP32P4_REV_MIN_1=y
CONFIG_ESP32P4_REV_MIN_FULL=1

# Flash: 16 MB
CONFIG_ESPTOOLPY_FLASHSIZE_16MB=y
CONFIG_ESPTOOLPY_FLASHSIZE="16MB"

# PSRAM: Hex-line 200 MHz (ESP32-P4 16-line interface)
CONFIG_SPIRAM_MODE_HEX=y
CONFIG_SPIRAM_SPEED_200M=y

# Disable PMP memory protection: user programs execute from PSRAM
# CONFIG_ESP_SYSTEM_MEMPROT_FEATURE is not set

# Network: use Ethernet (RMII, IP101GRR PHY) — no WiFi coprocessor on this board.
CONFIG_MOS_NET_ETHERNET=y

# Ethernet pin mapping for Olimex ESP32-P4-PC Rev B (from schematic)
CONFIG_MOS_ETH_PHY_ADDR=1
CONFIG_MOS_ETH_RMII_CLK_GPIO=50
CONFIG_MOS_ETH_TXEN_GPIO=33
CONFIG_MOS_ETH_TXD0_GPIO=34
CONFIG_MOS_ETH_TXD1_GPIO=35
CONFIG_MOS_ETH_RXD0_GPIO=29
CONFIG_MOS_ETH_RXD1_GPIO=30
CONFIG_MOS_ETH_RXDV_GPIO=28
CONFIG_MOS_ETH_MDC_GPIO=31
CONFIG_MOS_ETH_MDIO_GPIO=52
CONFIG_MOS_ETH_PHY_RST_GPIO=51
# Wait up to 5 s for link + DHCP; continue without network if cable is unplugged
CONFIG_MOS_ETH_LINK_TIMEOUT_MS=5000

# ES8311 audio codec (I2S + I2C, 48000 Hz stereo)
# Olimex ESP32-P4-PC: I2C1 SDA=GPIO7 SCL=GPIO8 (port 1 — same as production test BSP_I2C_NUM=1)
# I2S0 GPIO9-13, PWR=GPIO6, PA=GPIO53
CONFIG_MOS_AUDIO_ENABLED=y
CONFIG_MOS_AUDIO_I2C_PORT=1
CONFIG_MOS_AUDIO_I2C_SDA_GPIO=7
CONFIG_MOS_AUDIO_I2C_SCL_GPIO=8
CONFIG_MOS_AUDIO_PWR_GPIO=6
CONFIG_MOS_AUDIO_PA_GPIO=53
CONFIG_MOS_AUDIO_I2S_NUM=1
CONFIG_MOS_AUDIO_I2S_DOUT_GPIO=9
CONFIG_MOS_AUDIO_I2S_WS_GPIO=10
CONFIG_MOS_AUDIO_I2S_DIN_GPIO=11
CONFIG_MOS_AUDIO_I2S_BCLK_GPIO=12
CONFIG_MOS_AUDIO_I2S_MCLK_GPIO=13
CONFIG_MOS_AUDIO_SAMPLE_RATE=16384

# LT8912B HDMI bridge (MIPI DSI → HDMI via I2C configuration)
# Olimex ESP32-P4-PC: I2C1 SDA=GPIO7 SCL=GPIO8 (port 1 — shared with ES8311)
CONFIG_LT8912B_ENABLED=y
CONFIG_LT8912B_I2C_PORT=1
CONFIG_LT8912B_SDA_GPIO=7
CONFIG_LT8912B_SCL_GPIO=8
CONFIG_LT8912B_HPD_GPIO=15
CONFIG_LT8912B_HDMI_MODE=y
CONFIG_LT8912B_DSI_LANES=2
# 1024×768@60Hz: pclk=56 MHz (Olimex BSP reduced blanking)
# IDF DPI clk = lane_mbps/8 / round(lane_mbps/8 / pclk)
# lane=896 → byte=112 MHz → div=round(112/56)=2 → real=56.0 MHz (exact)
# Bandwidth: 56 MHz × 24 / 2 lanes = 672 Mbps < 896 Mbps ✓
CONFIG_LT8912B_DSI_LANE_MBPS=896

# mos_kbd component — USB HID keyboard via IDF usb_host (no managed component)
CONFIG_MOS_KBD_ENABLED=y
CONFIG_MOS_KBD_HUB_RST_GPIO=21
CONFIG_MOS_KBD_USB_DP_GPIO=27
CONFIG_MOS_KBD_USB_DM_GPIO=26

# USB hub support: FE1.1s 4-port hub sits between OTG20 HS and the keyboard.
# HUBS_SUPPORTED enables the IDF hub driver; MULTI_LEVEL allows the single
# level of nesting (root → FE1.1s → keyboard).
CONFIG_USB_HOST_HUBS_SUPPORTED=y
CONFIG_USB_HOST_HUB_MULTI_LEVEL=y

# esp-hosted / WiFi coprocessor — this board has no C6 coprocessor.
# The managed component enables itself by default; override to disable.
# Kconfig uses "# CONFIG_x is not set" to reliably disable a boolean.
# CONFIG_ESP_HOSTED_ENABLED is not set

# Console: use built-in USB Serial/JTAG (USB-C connector on the board)
# Primary UART console is disabled; JTAG port acts as both debugger and monitor.
CONFIG_ESP_CONSOLE_USB_SERIAL_JTAG=y
CONFIG_ESP_CONSOLE_SECONDARY_NONE=y

# Ethernet: enable internal EMAC (RMII, external PHY via GPIO matrix)
CONFIG_ETH_ENABLED=y
CONFIG_ETH_USE_ESP32_EMAC=y
CONFIG_ETH_PHY_INTERFACE_RMII=y
CONFIG_ETH_DMA_BUFFER_SIZE=512
CONFIG_ETH_DMA_RX_BUFFER_NUM=20
CONFIG_ETH_DMA_TX_BUFFER_NUM=10

# I2C ISR in IRAM — prevents ESP_ERR_INVALID_STATE when flash cache is busy.
# The production test has this set; without it the ISR may not fire in time
# and i2c_master_transmit returns INVALID_STATE (status never reaches DONE).
CONFIG_I2C_MASTER_ISR_HANDLER_IN_IRAM=y

# Internal VDP: HDMI framebuffer renderer (esp32-mos-hfq)
CONFIG_MOS_VDP_INTERNAL_ENABLED=y
CONFIG_MOS_VDP_INTERNAL_DEFAULT_MODE=0
CONFIG_MOS_VDP_INTERNAL_TASK_STACK_KB=16
```
